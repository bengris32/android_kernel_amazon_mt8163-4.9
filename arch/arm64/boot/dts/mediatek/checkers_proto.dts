/*
 * Copyright (C) 2018 Amazon.com
 *
 * This program is free software: you can redistribute it and/or modify
 * it under the terms of the GNU General Public License version 2 as
 * published by the Free Software Foundation.
 *
 * This program is distributed in the hope that it will be useful,
 * but WITHOUT ANY WARRANTY; without even the implied warranty of
 * MERCHANTABILITY or FITNESS FOR A PARTICULAR PURPOSE. See the
 * GNU General Public License for more details.
 *
 */

/dts-v1/;

#include "checkers.dtsi"

/ {
        version = "proto";
};

&kd_camera_hw1 {
	cam-en-gpios = <&pio 23 GPIO_ACTIVE_HIGH>;
	cam-pwr-en-gpios = <&pio 45 GPIO_ACTIVE_HIGH>;
};
